## buildroot/buildroot-201902/configs/sun8iw20p1_t113_nand_defconfig
```kconfig
BR2_arm=y
BR2_cortex_a7=y
BR2_ARM_EABI=y
BR2_TOOLCHAIN_EXTERNAL=y
BR2_TARGET_GENERIC_HOSTNAME="TinaLinux"
BR2_TARGET_GENERIC_ISSUE="Welcome to Allwinner TinaLinux Platform"
BR2_ROOTFS_DEVICE_CREATION_DYNAMIC_EUDEV=y
BR2_TARGET_GENERIC_GETTY_BAUDRATE_115200=y
BR2_ROOTFS_OVERLAY="$(TOPDIR)/../100ask"
BR2_PACKAGE_SDK_MEMORY_TEST=y
BR2_PACKAGE_ALPHA_TEST=y
BR2_PACKAGE_LCD_BRIGHT_TEST=y
BR2_PACKAGE_MEM_TEST_DE=y
BR2_PACKAGE_YUV_TEST=y
BR2_PACKAGE_SDK_G2D_TEST=y
BR2_PACKAGE_SDK_COMMON=y
BR2_PACKAGE_CSI_TEST=y
BR2_PACKAGE_FBINIT_TEST=y
BR2_PACKAGE_GPIO_TEST=y
BR2_PACKAGE_MULTISCREEN_TEST=y
BR2_PACKAGE_TPADC_TEST=y
BR2_PACKAGE_SDK_ENDEC=y
BR2_PACKAGE_SDK_DECODER_TEST=y
BR2_PACKAGE_SDK_ENCODER_TEST=y
BR2_PACKAGE_SDK_GIF2RGB_TEST=y
BR2_PACKAGE_SDK_CAMERA=y
BR2_PACKAGE_AUDIO_ENC_TEST=y
BR2_PACKAGE_DVR_TEST=y
BR2_PACKAGE_RECORD_TEST=y
BR2_PACKAGE_TVD_TEST=y
BR2_PACKAGE_USB_CAMERA_TEST=y
BR2_PACKAGE_SDK_PLAYER=y
BR2_PACKAGE_AUTPLAYER_TEST=y
BR2_PACKAGE_STREAM_LAYER_TEST=y
CONFIG_XPLAYER_DEMO=y
BR2_PACKAGE_TPLAYERDEMO=y
BR2_PACKAGE_TRECORDERDEMO=y
BR2_PACKAGE_BACKPLAYDEMO=y
BR2_PACKAGE_JPEGDECODEDEMO=y
BR2_PACKAGE_ENCODERTEST=y
BR2_PACKAGE_TPLAYER=y
BR2_PACKAGE_TRECORDER=y
BR2_PACKAGE_AMP_SHELL=y
BR2_PACKAGE_BUSYBOX_INIT_BASE_FILES=y
BR2_PACKAGE_OTA_BURNBOOT=y
BR2_PACKAGE_RPBUF=y
BR2_PACKAGE_RPBUF_DEMO=y
BR2_PACKAGE_RPBUF_TEST=y
BR2_PACKAGE_RPMSG=y
BR2_PACKAGE_RPMSG_DEMO=y
BR2_PACKAGE_RPMSG_TEST=y
BR2_PACKAGE_ADBD=y
BR2_PACKAGE_WIFI_FIRMWARE=y
BR2_PACKAGE_XR829_FIRMWARE=y
BR2_PACKAGE_XR829_USE_24M=y
BR2_PACKAGE_LV_G2D_TEST=y
BR2_PACKAGE_ALSA_UTILS=y
BR2_PACKAGE_ALSA_UTILS_AMIXER=y
BR2_PACKAGE_ALSA_UTILS_APLAY=y
BR2_PACKAGE_MTD=y
BR2_PACKAGE_UBOOT_TOOLS=y
BR2_PACKAGE_UBOOT_TOOLS_UBINAND_HAVEREDUNDENV=y
BR2_PACKAGE_LIBCURL=y
BR2_PACKAGE_LIBLDNS=y
BR2_PACKAGE_LIBRSYNC=y
BR2_PACKAGE_DHCPCD=y
BR2_PACKAGE_IW=y
BR2_PACKAGE_WPA_SUPPLICANT=y
BR2_PACKAGE_ANDROID_TOOLS=y
BR2_PACKAGE_SWUPDATE=y
SWUPDATE_CONFIG_MTD=y
SWUPDATE_CONFIG_UBIVOL=y
```

## kernel/linux-5.4/drivers/misc/epd_100ask/Kconfig
```kconfig
config EPD_100ASK_240X360
	tristate "100ASK 240x360 SPI EPD driver"
	depends on SPI
	depends on GPIOLIB
	help
	  100ASK 240x360 SPI e-paper display driver for Linux 5.4.
```
